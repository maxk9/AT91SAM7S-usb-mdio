

#include <board.h>
#include <spid.h>
#include <pio.h>
#include <lcd_siem_s65.h>
#include <string.h>



// ascii table, starting with character blank (32)
// size is 8x14


// массив символов
const uint8_t ascii_tab[167][14]={
{ 0x00, 0x00, 0x00, 0x00, 0x00, 0x00, 0x00, 0x00, 0x00, 0x00, 0x00, 0x00, 0x00, 0x00}, // space (32)
{ 0x00, 0x00, 0x00, 0x18, 0x3c, 0x3c, 0x3c, 0x18, 0x18, 0x00, 0x18, 0x18, 0x00, 0x00}, // !
{ 0x00, 0x66, 0x66, 0x66, 0x24, 0x00, 0x00, 0x00, 0x00, 0x00, 0x00, 0x00, 0x00, 0x00}, // "
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{ 0x00, 0x00, 0x00, 0x00, 0x00, 0x00, 0x7e, 0xc6, 0xc6, 0x7e, 0x26, 0x66, 0x00, 0x00}  // я     255
};


uint16_t LCD_backcolor=0xFFFF;    // color of background
uint16_t LCD_textcolor=0x0000;

 



/* ------------------------------------------------------------------------- */
//интерфейс к lCD

/// LED #0 pin definition (PA0).
#define PIN_LCD_RS   {AT91C_PIO_PA7, AT91C_BASE_PIOA, AT91C_ID_PIOA, PIO_OUTPUT_0, PIO_DEFAULT}
/// LED #1 pin definition (PA31).
#define PIN_LCD_RESET   {AT91C_PIO_PA31, AT91C_BASE_PIOA, AT91C_ID_PIOA, PIO_OUTPUT_0, PIO_DEFAULT}
#define PIN_LCD_CS  	{AT91C_PIO_PA11, AT91C_BASE_PIOA, AT91C_ID_PIOA, PIO_OUTPUT_1, PIO_DEFAULT}
//#define PINS_LCD_ctrl   PIN_LCD_RS, PIN_LCD_RESET, PIN_LCD_CS

static const Pin pinsLCD[] = {PIN_LCD_RS, PIN_LCD_RESET};

#define LCD_CS_HIGH		AT91C_BASE_SPI->SPI_MR |= (AT91C_SPI_PCS);//cs set is 0 channel
#define LCD_CS_LOW		AT91C_BASE_SPI->SPI_MR &= (~AT91C_SPI_PCS);//cs set is 0 channel

//#define LCD_CS_HIGH PIO_Set(&pinsLCD[2])
//#define LCD_CS_LOW PIO_Clear(&pinsLCD[2])
//#define LCD_CS_HIGH		UTIL_WaitTimeInUs(BOARD_MCK,1)
//#define LCD_CS_LOW		UTIL_WaitTimeInUs(BOARD_MCK,1)
//------------------------------------------------------------------------------
/// Wait time in ms
//------------------------------------------------------------------------------
 void UTIL_WaitTimeInMs(uint32_t mck, uint16_t time_ms)
{
    volatile uint16_t i = 0;
    i = (mck / 1000) * time_ms;
    i = i / 3;
	 while(i--);	
    //UTIL_Loop(i);
}

//------------------------------------------------------------------------------
/// Wait time in us
//------------------------------------------------------------------------------
 void UTIL_WaitTimeInUs(uint32_t mck, uint16_t time_us)
{
    volatile uint16_t i = 0;
    i = (mck / 1000000) * time_us;
    i = i / 3;
	 while(i--);	
    //UTIL_Loop(i);
}



/*посылка команды на LCD*/
void lcd_wr_com(uint16_t val)
{
	while(!(READ_SPI(AT91C_BASE_SPI,SPI_SR)&AT91C_SPI_TDRE));
	WRITE_SPI(AT91C_BASE_SPI, SPI_TDR, 0x74);
	while(!(READ_SPI(AT91C_BASE_SPI,SPI_SR)&AT91C_SPI_TDRE));
	WRITE_SPI(AT91C_BASE_SPI, SPI_TDR, 0x00);
	while(!(READ_SPI(AT91C_BASE_SPI,SPI_SR)&AT91C_SPI_TDRE));
	WRITE_SPI(AT91C_BASE_SPI, SPI_TDR, (val&0xFF));
	
	UTIL_WaitTimeInUs(BOARD_MCK,1);
	
}

/*посылка команды на LCD*/
void lcd_wr_dat(uint8_t val1,uint8_t val2)
{

	while(!(READ_SPI(AT91C_BASE_SPI,SPI_SR)&AT91C_SPI_TDRE));
	WRITE_SPI(AT91C_BASE_SPI, SPI_TDR, 0x76);
	while(!(READ_SPI(AT91C_BASE_SPI,SPI_SR)&AT91C_SPI_TDRE));
	WRITE_SPI(AT91C_BASE_SPI, SPI_TDR, val1);
	while(!(READ_SPI(AT91C_BASE_SPI,SPI_SR)&AT91C_SPI_TDRE));
	WRITE_SPI(AT91C_BASE_SPI, SPI_TDR, val2);
	UTIL_WaitTimeInUs(BOARD_MCK,1);
	
}
// запись одного байта в дисплей
void lcd_write8(uint8_t dat)
{
	//READ_SPI(AT91C_BASE_SPI, SPI_RDR);
	//READ_SPI(AT91C_BASE_SPI, SPI_SR);
 while(!(READ_SPI(AT91C_BASE_SPI,SPI_SR)&AT91C_SPI_TDRE));
	WRITE_SPI(AT91C_BASE_SPI, SPI_TDR, dat&0xFF);
}

// запись двух байт
void lcd_write(uint16_t dat)
{
  lcd_write8((dat>>8)&0xFF);
  lcd_write8 (dat&0xFF);
}

// дергаем выводом CS для обозначения конца передачи данных
void lcd_cspulse(void)
{
	//UTIL_WaitTimeInUs(BOARD_MCK,1);
//	LCD_CS_HIGH;
//	__nop();
//	LCD_CS_LOW;
	UTIL_WaitTimeInUs(BOARD_MCK,5);
}

// выбор регистра в контроллере дисплея
void lcd_reg(uint8_t register_name)
{
  lcd_write8(0x74);  // стартовый байт на передачу команды
  lcd_write(register_name);
  lcd_cspulse();
}

// отправка двух байт в графическую память дисплея
void lcd_dat8(uint8_t register_dat1, uint8_t register_dat2)
{
  lcd_write8(0x76);  // стартовый байт на запись данных
  lcd_write8(register_dat1);
  lcd_write8(register_dat2);
  lcd_cspulse();
  
}

// то же самое, но из 16-и битной переменной
void lcd_dat(uint16_t data)
{
  lcd_write8(0x76);  // стартовый байт на запись данных
  lcd_write(data);
  lcd_cspulse();
}


// программа инициализации дисплея
void init_lcd(void)
{
	PIO_Configure(pinsLCD, PIO_LISTSIZE(pinsLCD));
	AT91C_BASE_SPI->SPI_MR &= (~AT91C_SPI_PCS);//cs set is 0 channel
	
	UTIL_WaitTimeInMs(BOARD_MCK,50);	
	PIO_Clear(&pinsLCD[1]);	//PIN_LCD_RESET	
	PIO_Clear(&pinsLCD[0]);	//PIN_LCD_RS	RS is not used, set it to high	
	UTIL_WaitTimeInMs(BOARD_MCK,1);
	PIO_Set(&pinsLCD[1]);	//PIN_LCD_RESET 
	UTIL_WaitTimeInMs(BOARD_MCK,10);
	
//	LCD_CS_LOW;
	UTIL_WaitTimeInMs(BOARD_MCK,15);
//  RESET=0;
//  CS=1;
//   UTIL_WaitTimeInMs(BOARD_MCK,10);
//  RESET=1;
//  
//  delay_ms(10);
//  
//  CS=0;
  
 
  lcd_reg(0x00);lcd_dat(0x0001);

  //lcd_reg(0x03);lcd_dat(0x000c);	//medium current
  lcd_reg(0x03);lcd_dat(0x0014);	//large current

  UTIL_WaitTimeInMs(BOARD_MCK,40);
  //lcd_reg(0x0d);lcd_dat(0x0616);
  lcd_reg(0x0d);lcd_dat(0x0016);	//Vci x –1.5

  lcd_reg(0x01);lcd_dat(0x0215);
  
  UTIL_WaitTimeInMs(BOARD_MCK,50);
  lcd_reg(0x07);lcd_dat(0x0037);
	
//	LCD_CS_HIGH;
	lcd_cspulse();
}

// заливка дисплея цветом color
void fill_screen(uint16_t color)
{
	uint16_t j=0, i=0;
//  LCD_CS_LOW;
  lcd_reg(0x16);lcd_dat(0x8300);
  lcd_reg(0x17);lcd_dat(0xAF00);
  lcd_reg(0x21);lcd_dat(0x0000);
  lcd_reg(0x22);lcd_write8(0x76);

  
  // start data transmission  
  for (i=0; i<DISP_H; i++)
	{
		for(j=0;j<DISP_W;j++)
		{
		lcd_write(color);
		}
	}
//	LCD_CS_HIGH;
//	lcd_cspulse();
	 UTIL_WaitTimeInMs(BOARD_MCK,1);

}
//==========================================================================================
//      Процедура заполнение цветом области
//==========================================================================================
// fill_area(10,14,32,16,BLUE); 
// Нарисовать прямоугольник с началом по х=10:у=14 с размером по х=32:у=16 цветом BLUE
void fill_area( uint8_t x1, uint8_t y1, uint8_t x2, uint8_t y2,uint16_t color)
{
     uint16_t i;
  //   uint16_t w,h;
		
	lcd_reg(0x05);lcd_dat(0x0030);
      lcd_reg(0x16);lcd_dat8(y2,y1);
      lcd_reg(0x17);lcd_dat8(x2,x1);
      lcd_reg(0x21);lcd_dat8(x1,y1);
      lcd_reg(0x22);lcd_write8(0x76);
	  
	/* lock globally interrupt */
    __disable_fiq();
	__disable_irq();
		
	//Пишем точку
//		w=x2-x1+1;
//		h=y2-y1+1;
    // for (i=0;i<w*h;i++) 
	 for (i=0;i<(7598);i++) 
     {
		 lcd_write(color);		 
     };
    /* unlock globally interrupt */
	__enable_fiq();
	__enable_irq();	 
	 
	 UTIL_WaitTimeInMs(BOARD_MCK,50);

}

void do_paint_area(uint16_t color)
{
	 uint16_t i;
   //  uint16_t w,h;
	
	lcd_reg(0x05);lcd_dat(0x0030);
	lcd_reg(0x16);lcd_dat8(DISP_W-1,0);
    lcd_reg(0x17);lcd_dat8(DISP_H-1,58);
	lcd_reg(0x21);lcd_dat8(0x00,0x00);
	lcd_reg(0x22);lcd_write8(0x76);
		/* lock globally interrupt */
    __disable_fiq();
	__disable_irq();
	for (i=0;i<(7598);i++) 
     {
		 lcd_write(color);
	 }
	     /* unlock globally interrupt */
	__enable_fiq();
	__enable_irq();
}

// поместить символ в графическую память дисплея
void put_char(uint8_t x, uint8_t y, uint8_t c, uint16_t color, uint8_t rot)
{
  uint8_t h,ch,p,mask;

  //LCD_CS_LOW;
  
  if(!rot)
  {
      lcd_reg(0x05);lcd_dat(0x0038);
      lcd_reg(0x17);lcd_dat8(x+CHAR_W-1, x);
      lcd_reg(0x16);lcd_dat8(y+CHAR_H-1, y);
      lcd_reg(0x21);lcd_dat8(x,y);
      lcd_reg(0x22);
      lcd_write8(0x76);  
  }
  else
  {
      lcd_reg(0x05);lcd_dat(0x0030);
      lcd_reg(0x16);lcd_dat8(x+CHAR_W-1, x);
      lcd_reg(0x17);lcd_dat8(y+CHAR_H-1, y);
      lcd_reg(0x21);lcd_dat8(y, x);
      lcd_reg(0x22);
      lcd_write8(0x76);  
  }

  
  for (h=0; h<CHAR_H; h++) // every column of the character
  {
       if (rot==1)
          ch=ascii_tab[ c-32 ][h];
          else
          ch=ascii_tab[ c-32 ][CHAR_H-h-1];
    
        mask=0x80;
        for (p=0; p<CHAR_W; p++)  // write the pixels
        {
          if (ch&mask)
          {
            lcd_write(color);                
          }
          else
          {
            lcd_write(LCD_backcolor);
          }
          //mask=mask/2;
		   mask=mask>>1;
        }  // for p
  }
//	LCD_CS_HIGH;
  lcd_cspulse();
}


// записать строку, начиная с координат x, y, цветом color и ориентацией orient
// если orient=0, то горизонтально, если =1, то вертикально
void LCD_put_string(uint8_t x, uint8_t y, char *str, uint8_t orient,uint16_t color)
{
	uint16_t j=0;
  //while (j<strlen(str))
  while (str[j]!=0)
  {
    put_char(x+j*CHAR_W,y,str[j], color,orient);   //  0 deg. rotated
    j++;
  }
}

/* ------------------------------------------------------------------------- */



